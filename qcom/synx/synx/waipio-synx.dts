/* Copyright (c) 2024 Qualcomm Innovation Center, Inc. All rights reserved.
 * SPDX-License-Identifier: BSD-3-Clause
 */
/dts-v1/;
/plugin/;

#include <dt-bindings/soc/qcom,ipcc.h>
#include <dt-bindings/interrupt-controller/arm-gic.h>
#include "waipio-synx.dtsi"

/ {
	model = "Qualcomm Technologies, Inc. waipio SoC";
	compatible = "qcom,cape", "qcom,waipio";
	qcom,msm-id = <457 0x10000>, <482 0x10000>,
			<457 0x20000>, <482 0x20000>,
			<530 0x10000>, <531 0x10000>,
			<540 0x10000>;
	qcom,board-id = <0 0>;
};
