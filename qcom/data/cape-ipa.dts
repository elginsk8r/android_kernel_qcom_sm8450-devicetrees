// SPDX-License-Identifier: BSD-3-Clause
/*
 * Copyright (c) 2024 Qualcomm Innovation Center, Inc. All rights reserved.
 */

/dts-v1/;
/plugin/;

#include <dt-bindings/interrupt-controller/arm-gic.h>
#include <dt-bindings/soc/qcom,ipcc.h>
#include <dt-bindings/interconnect/qcom,parrot.h>
#include <dt-bindings/clock/qcom,gcc-parrot.h>
#include <dt-bindings/clock/qcom,rpmh.h>
#include "cape-ipa.dtsi"

/ {
	model = "Qualcomm Technologies, Inc. Cape SoC";
	compatible = "qcom,cape";
	qcom,msm-id = <530 0x10000>, <531 0x10000>, <540 0x10000>;
};
